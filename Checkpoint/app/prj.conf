## CMakeLists.txt
```
# SPDX-License-Identifier: Apache-2.0

cmake_minimum_required(VERSION 3.20.0)
find_package(Zephyr REQUIRED HINTS $ENV{ZEPHYR_BASE})
project(PathPatrol)

target_sources(app PRIVATE src/main.c src/mqtt_connection.c src/network.c src/nfc.c src/passing_buffer.c)
```

## Kconfig
```
menu "KRUKE Trail Running Checkpoints"

config MQTT_PUB_TOPIC
    string "MQTT publish topic"
    default "devacademy/publish/topic"

config MQTT_SUB_TOPIC
    string "MQTT subscribe topic"
    default "devacademy/subscribe/topic"

config MQTT_SUBSCRIBE
    bool "Subscribe to configure topic"
    default n
    help
      Configure whether or not you wish to subscribe to the configured topic.

config MQTT_CLIENT_ID
    string "MQTT client ID"
    help
      Use a custom Client ID string. If not set, the Client ID will be generated based on the IMEI number (for nRF91 Series based targets) or randomly (for other platforms).
    default ""

config MQTT_BROKER_HOSTNAME
    string "MQTT broker hostname"
    default "test.mosquitto.org"
    
config MQTT_BROKER_PORT
    int "MQTT broker port"
    default 8883

config MQTT_MESSAGE_BUFFER_SIZE
    int "MQTT message buffer size"
    default 128

config MQTT_PAYLOAD_BUFFER_SIZE
    int "MQTT payload buffer size"
    default 128

config MQTT_RECONNECT_DELAY_S
    int "Seconds to delay before attempting to reconnecting to the broker."
    default 10

config MQTT_TLS_SEC_TAG
    int "TLS credentials security tag"
    default 24

config MQTT_TLS_SESSION_CACHING
    bool "Enable TLS session caching"

config MQTT_TLS_PEER_VERIFY
    int "Set peer verification level"
    default 2
    help
      Set to 0 for VERIFY_NONE, 1 for VERIFY_OPTIONAL, and 2 for VERIFY_REQUIRED.

config MQTT_USERNAME
    string "Set username for mqtt authentication"
    default NULL
    
config MQTT_PASSWORD
    string "Set password for mqtt authentication"
    default NULL

config MQTT_PUBLISH_TIMER_MS
    int "Time in milliseconds for how long the publish thread should sleep before attemping to publish buffered RFID registrations"
    default 10000

config MQTT_NFC_SCAN_TIMER_MS
    int "Time in milliseconds for how long the NFC scanning thread should sleep before attemping a new scan"
    default 2000

endmenu

source "Kconfig.zephyr"
```

## prj.conf
```kconfig
# GPIO
CONFIG_GPIO=y

# I2C
CONFIG_I2C=y
#CONFIG_SHELL=y
#CONFIG_I2C_SHELL=y

# Logging
CONFIG_LOG=y

# Newlib
CONFIG_NEWLIB_LIBC=y

# Bootlodaer MCUBoot
CONFIG_BOOTLOADER_MCUBOOT=y

# Networking
CONFIG_NETWORKING=y
CONFIG_NET_NATIVE=n
CONFIG_NET_SOCKETS=y
CONFIG_NET_SOCKETS_OFFLOAD=y
CONFIG_NET_SOCKETS_POSIX_NAMES=y

# Memory
CONFIG_MAIN_STACK_SIZE=2048
CONFIG_HEAP_MEM_POOL_SIZE=4096
CONFIG_NRF_MODEM_LIB_HEAP_SIZE=4096

# Modem library
CONFIG_NRF_MODEM_LIB=y

# Enable the modem key management library
CONFIG_MODEM_KEY_MGMT=y

# LTE link control
CONFIG_LTE_LINK_CONTROL=y
CONFIG_LTE_NETWORK_MODE_LTE_M_NBIOT=y

# AT commands interface
CONFIG_AT_HOST_LIBRARY=y
CONFIG_UART_INTERRUPT_DRIVEN=y

# MQTT
CONFIG_MQTT_LIB=y
CONFIG_MQTT_CLEAN_SESSION=y
CONFIG_MQTT_LIB_TLS=y

# Server/Client authentication & configuration
CONFIG_MQTT_PUB_TOPIC="postcheckpoint"
CONFIG_MQTT_USERNAME="asdf"
CONFIG_MQTT_PASSWORD="mqtt1234"
CONFIG_MQTT_BROKER_HOSTNAME="o4b81453.ala.eu-central-1.emqxsl.com"
CONFIG_MQTT_PUBLISH_TIMER_MS=100
```

## src/main.c
```c
#include <zephyr/kernel.h>
#include <zephyr/device.h>
#include <zephyr/devicetree.h>
#include <zephyr/drivers/i2c.h>
#include <zephyr/drivers/gpio.h>
#include <zephyr/sys/util.h>
#include <zephyr/logging/log.h>

#include "network.h"
#include "nfc.h"
#include "passing_buffer.h"
#include "mqtt_connection.h"

LOG_MODULE_REGISTER(PathPatrol, LOG_LEVEL_INF);

struct passing_buffer passing_buffer;

/* Semaphore for mutexing the shared RFID buffer. */
K_SEM_DEFINE(buffer_semaphore, 1, 1);

/* Semaphores for preventing thread execution before initializations in the main() thread have finished. */
K_SEM_DEFINE(publish_semaphore, 0, 1);
K_SEM_DEFINE(keepalive_semaphore, 0, 1);
K_SEM_DEFINE(tag_reader_semaphore, 0, 1);

/** @brief Entrypoint function for the NFC tag reader thread. This function never returns.
 *  @param buffer The passing_buffer to enqueue RFID reads to.
*/
void tag_reader_thread(struct passing_buffer *buffer) {
    k_sem_take(&tag_reader_semaphore, K_FOREVER); // wait for main

    uint32_t rfid_tag = 0;
    uint64_t time = 0;
    while(1) {
        int ret = pn532_get_tag(&rfid_tag);

        k_sem_take(&buffer_semaphore, K_FOREVER);
        if (ret == 0) {
            time = (k_cycle_get_32()*1000)/sys_clock_hw_cycles_per_sec();
            enqueue(buffer, &rfid_tag, &time);
            LOG_INF("%x added to buffer, %d new size", rfid_tag, buffer->size);
        }
        k_sem_give(&buffer_semaphore);
        k_msleep(CONFIG_MQTT_NFC_SCAN_TIMER_MS);
    }
}

/** @brief Main entry point, initializes code, then returns to kill the main thread.
 *  @returns Non-zero value on error, 0 if success.
*/
int main(void){
    int err;

    LOG_INF("Initializing NFC");
    err = pn532_nfc_setup();
    if (err){
        LOG_ERR("NFC setup failed, error: %d", err);
        return err;
    }
	err = network_init();
    if (err) {
        LOG_ERR("Network init error: %d", err);
        return err;
    }
    
    LOG_INF("Giving tag_reader_semaphore.");
    k_sem_give(&tag_reader_semaphore);
    LOG_INF("Giving keepalive_semaphore.");
    k_sem_give(&keepalive_semaphore);
    LOG_INF("Giving publish_semaphore.");
    k_sem_give(&publish_semaphore);
    return 0;
}

// Define and start the three threads at their corresponding entrypoints.
K_THREAD_DEFINE(thread0_id, 1024, mqtt_keepalive_thread, NULL, NULL, NULL,
		4, 0, 1000);
K_THREAD_DEFINE(thread1_id, 1024, tag_reader_thread, &passing_buffer, NULL, NULL,
		6, 0, 1000);
K_THREAD_DEFINE(thread2_id, 2048, publish_thread, &passing_buffer, NULL, NULL,
		5, 0, 10000);
```

## src/certificate.h
```c
#define CA_CERTIFICATE \
"-----BEGIN CERTIFICATE-----\n" \
"MIIDrzCCApegAwIBAgIQCDvgVpBCRrGhdWrJWZHHSjANBgkqhkiG9w0BAQUFADBh\n" \
"MQswCQYDVQQGEwJVUzEVMBMGA1UEChMMRGlnaUNlcnQgSW5jMRkwFwYDVQQLExB3\n" \
"d3cuZGlnaWNlcnQuY29tMSAwHgYDVQQDExdEaWdpQ2VydCBHbG9iYWwgUm9vdCBD\n" \
"QTAeFw0wNjExMTAwMDAwMDBaFw0zMTExMTAwMDAwMDBaMGExCzAJBgNVBAYTAlVT\n" \
"MRUwEwYDVQQKEwxEaWdpQ2VydCBJbmMxGTAXBgNVBAsTEHd3dy5kaWdpY2VydC5j\n" \
"b20xIDAeBgNVBAMTF0RpZ2lDZXJ0IEdsb2JhbCBSb290IENBMIIBIjANBgkqhkiG\n" \
"9w0BAQEFAAOCAQ8AMIIBCgKCAQEA4jvhEXLeqKTTo1eqUKKPC3eQyaKl7hLOllsB\n" \
"CSDMAZOnTjC3U/dDxGkAV53ijSLdhwZAAIEJzs4bg7/fzTtxRuLWZscFs3YnFo97\n" \
"nh6Vfe63SKMI2tavegw5BmV/Sl0fvBf4q77uKNd0f3p4mVmFaG5cIzJLv07A6Fpt\n" \
"43C/dxC//AH2hdmoRBBYMql1GNXRor5H4idq9Joz+EkIYIvUX7Q6hL+hqkpMfT7P\n" \
"T19sdl6gSzeRntwi5m3OFBqOasv+zbMUZBfHWymeMr/y7vrTC0LUq7dBMtoM1O/4\n" \
"gdW7jVg/tRvoSSiicNoxBN33shbyTApOB6jtSj1etX+jkMOvJwIDAQABo2MwYTAO\n" \
"BgNVHQ8BAf8EBAMCAYYwDwYDVR0TAQH/BAUwAwEB/zAdBgNVHQ4EFgQUA95QNVbR\n" \
"TLtm8KPiGxvDl7I90VUwHwYDVR0jBBgwFoAUA95QNVbRTLtm8KPiGxvDl7I90VUw\n" \
"DQYJKoZIhvcNAQEFBQADggEBAMucN6pIExIK+t1EnE9SsPTfrgT1eXkIoyQY/Esr\n" \
"hMAtudXH/vTBH1jLuG2cenTnmCmrEbXjcKChzUyImZOMkXDiqw8cvpOp/2PV5Adg\n" \
"06O/nVsJ8dWO41P0jmP6P6fbtGbfYmbW0W5BjfIttep3Sp+dWOIrWcBAI+0tKIJF\n" \
"PnlUkiaY4IBIqDfv8NZ5YBberOgOzW6sRBc4L0na4UU+Krk2U886UAb3LujEV0ls\n" \
"YSEY1QSteDwsOoBrp+uvFRTp2InBuThs4pFsiv9kuXclVzDAGySj4dzp30d8tbQk\n" \
"CAUw7C29C79Fv1C5qfPrmAESrciIxpg0X40KPMbp1ZWVbd4=\n" \
"-----END CERTIFICATE-----\n"
```

## src/mqtt_connection.c
```c
#include <stdio.h>
#include <string.h>
#include <stdlib.h>
#include <ncs_version.h>

#include <zephyr/logging/log.h>
#include <zephyr/kernel.h>
#include <zephyr/net/socket.h>
#include <zephyr/net/mqtt.h>
#include <nrf_modem_at.h>
#include <modem/modem_key_mgmt.h>

#include "mqtt_connection.h"
#include "network.h"
#include "certificate.h"

#if NCS_VERSION_NUMBER < 0x20600
#include <zephyr/random/rand32.h>
#else
#include <zephyr/random/random.h>
#endif

// Enable logging for this file
LOG_MODULE_DECLARE(PathPatrol);

// MQTT client buffers
static uint8_t rx_buffer[CONFIG_MQTT_MESSAGE_BUFFER_SIZE];
static uint8_t tx_buffer[CONFIG_MQTT_MESSAGE_BUFFER_SIZE];
static uint8_t payload_buf[CONFIG_MQTT_PAYLOAD_BUFFER_SIZE];

// MQTT Client username and password initialization
static struct mqtt_utf8 username = {
    .utf8 = "NULL",
    .size = 0
};
static struct mqtt_utf8 password = {
    .utf8 = "NULL",
    .size = 0
};

// String format IMEI number. Used as checkpoint ID.
char imei_str[IMEI_LEN + 1] = {0};

// MQTT broker details
static struct sockaddr_storage broker;

/** @brief Stores the certificate for the server on the modem.
 *  @returns Non-zero value on error, 0 if success.
*/
int certificate_provision(void) {
    int err = 0;
    bool exists;

    LOG_INF("Checking for certificates.");
    err = modem_key_mgmt_exists(CONFIG_MQTT_TLS_SEC_TAG, MODEM_KEY_MGMT_CRED_TYPE_CA_CHAIN, &exists);
    if (err) {
        LOG_ERR("Failed to check for certificates, err: %d", err);
        return err;
    }

    LOG_INF("%s", exists ? "Exists" : "Doesn't exist");
    if (exists) {
        err = modem_key_mgmt_cmp(CONFIG_MQTT_TLS_SEC_TAG, MODEM_KEY_MGMT_CRED_TYPE_CA_CHAIN, CA_CERTIFICATE, strlen(CA_CERTIFICATE));
        LOG_INF("Certificate %s", err ? "mismatch" : "match");
        if (!err) {
            return err;
        }
    }
    LOG_INF("Provisioning certificates");
    err = modem_key_mgmt_write(CONFIG_MQTT_TLS_SEC_TAG, MODEM_KEY_MGMT_CRED_TYPE_CA_CHAIN, CA_CERTIFICATE, strlen(CA_CERTIFICATE));
    if (err) {
        LOG_ERR("Failed to provision CA certificate: %d", err);
        return err;
    }
    return err;
}

/** @brief Function to subscribe to the configured topic.
 *  See CONFIG_MQTT_SUB_TOPIC for configured subscription topic.
 */
static int subscribe(struct mqtt_client *const c)
{
	struct mqtt_topic subscribe_topic = {
		.topic = {
			.utf8 = CONFIG_MQTT_SUB_TOPIC,
			.size = strlen(CONFIG_MQTT_SUB_TOPIC)
		},
		.qos = MQTT_QOS_1_AT_LEAST_ONCE
	};

	const struct mqtt_subscription_list subscription_list = {
		.list = &subscribe_topic,
		.list_count = 1,
		.message_id = 1234
	};

	LOG_INF("Subscribing to: %s len %u", CONFIG_MQTT_SUB_TOPIC,
		(unsigned int)strlen(CONFIG_MQTT_SUB_TOPIC));

	return mqtt_subscribe(c, &subscription_list);
}

/** @brief Function to get the payload of received data.
 *  @returns Non-zero value on error, 0 if success.
*/
static int get_received_payload(struct mqtt_client *c, size_t length) {
    int ret;
    int err = 0;
    /* Return an error if the payload is larger than the payload buffer.
	 * Note: To allow new messages, we have to read the payload before returning.
	 */
    if (length > sizeof(payload_buf)) {
        err = -EMSGSIZE;
    }

    /* Truncate payload until it fits in the payload buffer. */
    while (length > sizeof(payload_buf)) {
        ret = mqtt_read_publish_payload_blocking(
            c, payload_buf, (length - sizeof(payload_buf)));
        if (ret == 0) {
            return -EIO;
        } else if (ret < 0) {
            return ret;
        }
        length -= ret;
    }

    ret = mqtt_readall_publish_payload(c, payload_buf, length);
    if (ret) {
        return ret;
    }

    return err;
}

/** @brief Function to print strings without null-termination
*/
static void data_print(uint8_t *prefix, uint8_t *data, size_t len) {
    char buf[len + 1];

    memcpy(buf, data, len);
    buf[len] = 0;
    LOG_INF("%s%s", (char *)prefix, (char *)buf);
}

/** @brief Function to publish data on the configured topic.
 *  See CONFIG_MQTT_PUB_TOPIC for configured publishing topic.
 *  @param c Pointer to client who is to publish the data.
 *  @param qos Quality of service for the published message.
 *  @param data Pointer to bytestream of data to publish.
 *  @param len Length of data.
 *  @returns 0 on success, negative error code on error.
*/
int data_publish(struct mqtt_client *c, enum mqtt_qos qos, uint8_t *data, size_t len) {
    struct mqtt_publish_param param;

    param.message.topic.qos = qos;
    param.message.topic.topic.utf8 = CONFIG_MQTT_PUB_TOPIC;
    param.message.topic.topic.size = strlen(CONFIG_MQTT_PUB_TOPIC);
    param.message.payload.data = data;
    param.message.payload.len = len;
    param.message_id = sys_rand32_get();
    param.dup_flag = 0;
    param.retain_flag = 0;

    data_print("Publishing: ", data, len);
    LOG_INF("to topic: %s len: %u", CONFIG_MQTT_PUB_TOPIC, (unsigned int)strlen(CONFIG_MQTT_PUB_TOPIC));

    return mqtt_publish(c, &param);
}

/** @brief MQTT client event handler.
 *  @param c Pointer to constant client whose events are to be handled by this event handler.
*/
void mqtt_evt_handler(struct mqtt_client *const c, const struct mqtt_evt *evt) {
    int err;

    switch (evt->type) {
        /* MQTT_EVT_CONNACK: Connection to broker established and acknowledged. */
        case MQTT_EVT_CONNACK:
            if (evt->result != 0) {
                LOG_ERR("MQTT connect failed: %d", evt->result);
                break;
            }
            #if CONFIG_MQTT_SUBSCRIBE == 1
            subscribe(&c);
            #endif
            break;
        
        /* MQTT_ECT_DISCONNECT: Broker disconnected client, typically due to not running mqtt_live() on time. */
        case MQTT_EVT_DISCONNECT:
            LOG_INF("MQTT client disconnected: %d", evt->result);
            /* Set to 0 such that publish thread doesn't attempt to publish
               data while the MQTT client is disconnected from the broker. */
		    is_mqtt_connected = 0;
            break;
        
        /* MQTT_EVT_PUBLISH: Receive data that has been published on a topic the client has subscribed to. */
        case MQTT_EVT_PUBLISH:
            const struct mqtt_publish_param *p = &evt->param.publish;
            /* Print length of received message */
            LOG_INF("MQTT PUBLISH result=%d len=%d", evt->result, p->message.payload.len);
            
            /* Extract data of received message */
            err = get_received_payload(c, p->message.payload.len);

            /* Send ack to broker on receiving QoS1 publish message */
            if (p->message.topic.qos == MQTT_QOS_1_AT_LEAST_ONCE) {
                const struct mqtt_puback_param ack = {
                    .message_id = p->message_id
                };
                mqtt_publish_qos1_ack(c, &ack);
            }

            /* On successful extraction of data */
            if (err >= 0) {
                data_print("Received: ", payload_buf, p->message.payload.len);
            } /* On failed extraction of data */
            else if (err == -EMSGSIZE) {
                LOG_ERR("Received payload (%d bytes) is larger than the payload buffer size (%d bytes).", 
                    p->message.payload.len, sizeof(payload_buf));
            } else {
                LOG_ERR("get_received_payload failed: %d", err);
                LOG_INF("Disconnecting MQTT client...");

                err = mqtt_disconnect(c);
                if (err) {
                    LOG_ERR("Could not disconnect: %d", err);
                }
            }

            break;

        /* MQTT_EVT_PUBACK: Broker ack-ed data that the client published. */
        case MQTT_EVT_PUBACK:
            if (evt->result != 0) {
                LOG_ERR("MQTT PUBACK error: %d", evt->result);
                break;
            }
            LOG_INF("PUBACK packet id: %u", evt->param.puback.message_id);
            break;

        /* MQTT_EVT_SUBACK: Subscription acknowledgement. */
        case MQTT_EVT_SUBACK:
            if (evt->result != 0) {
                LOG_ERR("MQTT SUBACK error: %d", evt->result);
                break;
            }
            LOG_INF("SUBACK packet id: %u", evt->param.suback.message_id);
            break;
        
        /* MQTT_EVT_PRINGRESP: Ping response from server. */
        case MQTT_EVT_PINGRESP:
            if (evt->result != 0) {
                LOG_ERR("MQTT PINGRESP error: %d", evt->result);
            }
            break;
        
        default:
            LOG_INF("Unhandled MQTT event type: %d", evt->type);
            break;
    }
}

/** @brief Resolves the configured hostname and initializes the MQTT broker structure.
 *  @returns Non-zero value on error, 0 if success.
*/
static int broker_init(void) {
    int err;
    struct addrinfo *result;
    struct addrinfo *addr;
    struct addrinfo hints = {
        .ai_family = AF_INET,
        .ai_socktype = SOCK_STREAM
    };

    err = getaddrinfo(CONFIG_MQTT_BROKER_HOSTNAME, NULL, &hints, &result);
    if (err) {
        LOG_ERR("getaddrinfo failed: %d", err);
        return -ECHILD;
    }

    addr = result;

    /* Look for address of the broker */
    while (addr != NULL) {
        /* IPv4 address */
        if (addr->ai_addrlen == sizeof(struct sockaddr_in)) {
            struct sockaddr_in *broker4 = ((struct sockaddr_in *)&broker);
            char ipv4_addr[NET_IPV4_ADDR_LEN];

            broker4->sin_addr.s_addr = ((struct sockaddr_in*)addr->ai_addr)->sin_addr.s_addr;
            broker4->sin_family = AF_INET;
            broker4->sin_port = htons(CONFIG_MQTT_BROKER_PORT);

            inet_ntop(AF_INET, &broker4->sin_addr.s_addr, ipv4_addr, sizeof(ipv4_addr));
            LOG_INF("IPv4 Address found %s", (char *)(ipv4_addr));

            break;
        } else {
            LOG_ERR("ai_addrlen = %u should be %u or %u",
                (unsigned int)addr->ai_addrlen,
                (unsigned int)sizeof(struct sockaddr_in),
                (unsigned int)sizeof(struct sockaddr_in6));
        }

        addr = addr->ai_next;
    }

    freeaddrinfo(result);

    return err;
}

/** @brief Function to get client id.
 *  If client_id has been defined in prj.conf, it picks that to use.
 *  If a custom client ID hasn't been defined, it picks the IMEI number of the device instead.
 *  To avoid issues with imei_init() not having been called before client_id_get(), this obtains
 *  the IMEI number from the modem without using the imei_str reference.
 *  @returns uint8_t* of client_id.
*/
static const uint8_t* client_id_get(void) {
    static uint8_t client_id[MAX(sizeof(CONFIG_MQTT_CLIENT_ID), CLIENT_ID_LEN)];

    if (strlen(CONFIG_MQTT_CLIENT_ID) > 0) {
        snprintf(client_id, sizeof(client_id), "%s", CONFIG_MQTT_CLIENT_ID);
        goto exit;
    }

    char imei_buf[CGSN_RESPONSE_LENGTH + 1];
    int err;

    err = nrf_modem_at_cmd(imei_buf, sizeof(imei_buf), "AT+CGSN");
    if (err) {
        LOG_ERR("Failed to obtain IMEI, error: %d", err);
        goto exit;
    }

    imei_buf[IMEI_LEN] = '\0';

    snprintf(client_id, sizeof(client_id), "nrf-%.*s", IMEI_LEN, imei_buf);

exit:
    LOG_DBG("client_id = %s", (char *)(client_id));
    return client_id;
}

/** @brief Initializes the global imei_str variable to be equal to the IMEI number of the device.
 *  @returns Non-zero value on error, 0 if success.
*/
int imei_init(void) {
    char imei_buf[CGSN_RESPONSE_LENGTH + 1];
    int err;

    err = nrf_modem_at_cmd(imei_buf, sizeof(imei_buf), "AT+CGSN");
    if (err) {
        LOG_ERR("Failed to obtain IMEI, error: %d", err);
        return -1;
    }

    imei_buf[IMEI_LEN] = '\0';

    snprintf(imei_str, IMEI_LEN + 1, "%s", imei_buf);

    imei_buf[IMEI_LEN + 1] = '\0';

    LOG_INF("IMEI: %s", imei_str);
    return 0;
}

/** @brief Initialize MQTT client structure.
 *  @param client Pointer to client object to initialize.
 *  @returns Non-zero value on error, 0 if success.
*/
int client_init(struct mqtt_client *client) {
    int err;
    /* Initializes the client instance. */
    mqtt_client_init(client);

    /* Rsolved hostname and initializes MQTT broker structure */
    err = broker_init();
    if (err) {
        LOG_ERR("Failed to initialize broker connection.");
        return err;
    }

    /* MQTT client configuration */
    client->broker = &broker;
    client->evt_cb = mqtt_evt_handler;
    client->client_id.utf8 = client_id_get();
    client->client_id.size = strlen(client->client_id.utf8);
    client->protocol_version = MQTT_VERSION_3_1_1;

    if (strcmp(CONFIG_MQTT_USERNAME, "NULL") != 0) {
        username.utf8 = CONFIG_MQTT_USERNAME;
        username.size = strlen(CONFIG_MQTT_USERNAME);
        client->user_name = &username;
    } else {
        client->user_name = NULL;
    }

    if (strcmp(CONFIG_MQTT_PASSWORD, "NULL") != 0) {
        password.utf8 = CONFIG_MQTT_PASSWORD;
        password.size = strlen(CONFIG_MQTT_PASSWORD);
        client->password = &password;
    } else{
        client->password = NULL;
    }
    
    LOG_INF("MQTT Client Username: %s", CONFIG_MQTT_USERNAME);
    LOG_INF("MQTT Client Password: %s", CONFIG_MQTT_PASSWORD);
    LOG_INF("MQTT Client ID: %s", client_id_get());

    /* MQTT buffers configuration */
    client->rx_buf = rx_buffer;
    client->rx_buf_size = sizeof(rx_buffer);
    client->tx_buf = tx_buffer;
    client->tx_buf_size = sizeof(tx_buffer);

    /* Using TLS */
    struct mqtt_sec_config *tls_cfg = &(client->transport).tls.config;
    static sec_tag_t sec_tag_list[] = { CONFIG_MQTT_TLS_SEC_TAG };

    LOG_INF("TLS enabled");
    client->transport.type = MQTT_TRANSPORT_SECURE;

    tls_cfg->peer_verify = CONFIG_MQTT_TLS_PEER_VERIFY;
    tls_cfg->cipher_list = NULL;
    tls_cfg->cipher_count = 0;
    tls_cfg->sec_tag_count = ARRAY_SIZE(sec_tag_list);
    tls_cfg->sec_tag_list = sec_tag_list;
    tls_cfg->hostname = CONFIG_MQTT_BROKER_HOSTNAME;
    
    tls_cfg->session_cache = IS_ENABLED(CONFIG_MQTT_TLS_SESSION_CACHING) ? TLS_SESSION_CACHE_ENABLED : TLS_SESSION_CACHE_DISABLED;

    return err;
}

/** @brief Initialize the file descriptor structure used by poll.
 *  @param c Pointer to client whose MQTT file descriptor is to be initialized.
 *  @param fds Pointer to client's pollfd.
*/
void fds_init(struct mqtt_client *c, struct pollfd *fds) {
    if (c->transport.type == MQTT_TRANSPORT_NON_SECURE) {
        fds->fd = c->transport.tcp.sock;
    } else {
        fds->fd = c->transport.tls.sock;
    }
    fds->events = POLLIN;
}
```

## src/mqtt_connection.h
```c
#ifndef _MQTTCONNECTION_H_
#define _MQTTCONNECTION_H_
#include <zephyr/net/mqtt.h>
#include <zephyr/net/socket.h>

#define IMEI_LEN 15
#define CGSN_RESPONSE_LENGTH (IMEI_LEN + 6 + 1) /* Add 6 for \r\nOK\r\n and 1 for \0 */
#define CLIENT_ID_LEN sizeof("nrf-") + IMEI_LEN

int client_init(struct mqtt_client *client);
void fds_init(struct mqtt_client *c, struct pollfd *fds);
int data_publish(struct mqtt_client *c, enum mqtt_qos qos, uint8_t *data, size_t len);
int certificate_provision(void);
int imei_init(void);

extern char imei_str[IMEI_LEN + 1];

#endif /* _MQTTCONNECTION_H_ */
```

## src/network.c
```c
#include <stdio.h>
#include <ncs_version.h>
#include <zephyr/kernel.h>
#include <zephyr/net/socket.h>
#include <zephyr/drivers/gpio.h>
#include <zephyr/logging/log.h>
#include <modem/nrf_modem_lib.h>
#include <modem/lte_lc.h>
#include <zephyr/net/mqtt.h>

#include "network.h"
#include "mqtt_connection.h"
#include "passing_buffer.h"

LOG_MODULE_DECLARE(PathPatrol);

/* MQTT client struct. */
static struct mqtt_client client;
/* File descriptor for MQTT connection. (Similar to fds for sockets.) */
static struct pollfd fds;

/* Global int to check if the client is still connected to the broker.
   Set to 1 if it's connected. */
int is_mqtt_connected = 0;

/* Get GPIO data for LED control. */
#define LED0_NODE DT_ALIAS(led0)
static const struct gpio_dt_spec led = GPIO_DT_SPEC_GET(LED0_NODE, gpios);

/* Semaphore to run lte_lc_connect_async() blocking in the main thread. */
static K_SEM_DEFINE(lte_connected, 0, 1);

/** @brief Event handler for LTE link control.
*/
static void lte_handler(const struct lte_lc_evt *const evt)
{
	switch (evt->type) {
	/* On changed registration status, print status. */
	case LTE_LC_EVT_NW_REG_STATUS:
		if ((evt->nw_reg_status != LTE_LC_NW_REG_REGISTERED_HOME) &&
			(evt->nw_reg_status != LTE_LC_NW_REG_REGISTERED_ROAMING)) {
			break;
		}
		LOG_INF("Network registration status: %s\n",
				evt->nw_reg_status == LTE_LC_NW_REG_REGISTERED_HOME ?
				"Connected - home network" : "Connected - roaming");
		k_sem_give(&lte_connected);
		break;

	/* On event RRC update, print RRC mode. */
	case LTE_LC_EVT_RRC_UPDATE:
		LOG_INF("RRC mode: %s\n", evt->rrc_mode == LTE_LC_RRC_MODE_CONNECTED ?
				"Connected" : "Idle");
		break;

	default:
		break;
	}
}

/** @brief Configures the modem and connects to LTE.
 *  First configures LED0, then initializes the modem library, then
 *  provisions the certificate, and then finally connects to cellular LTE-M.
 *  @returns Non-zero value on error, 0 if success.
*/
static int modem_configure(void)
{
	int err;

	if (!gpio_is_ready_dt(&led)) {
		LOG_ERR("LED not ready.");
		return -1317;
	}
	err = gpio_pin_configure_dt(&led, GPIO_OUTPUT_ACTIVE);
	if (err) {
		LOG_ERR("Failed to configure LED, error: %d", err);
		return err;
	}
	LOG_INF("LED is ready and configured.");

	LOG_INF("Initializing modem library\n");
	err = nrf_modem_lib_init(NORMAL_MODE);
	if (err) {
		LOG_ERR("Failed to initialize the modem library, error: %d", err);
		return err;
	}

	/* CircuitDojo nRF9160 Feather likes to conect to LTE before running main,
	   LTE connection must be offline to provision certificate. */
	LOG_INF("Disconnecting from open LTE connection.");
	err = lte_lc_offline();
	if (err) {
		LOG_ERR("Failed to disconnect from LTE connection, error: %d", err);
		err = 0;
	}

	/* Store certificate in the modem while the modem is in offline mode. */
	err = certificate_provision();
	if (err != 0) {
		LOG_ERR("Failed to provision certificates");
		return err;
	}

	/* lte_lc_init deprecated in >= v2.6.0 */
	#if NCS_VERSION_NUMBER < 0x20600
	err = lte_lc_init();
	if (err) {
		LOG_ERR("Failed to initialize LTE link control library, error: %d", err);
		return err;
	}
	#endif
	
	LOG_INF("Connecting to LTE network\n");
	err = lte_lc_connect_async(lte_handler);
	if (err) {
		LOG_ERR("Error in lte_lc_connect_async, error: %d", err);
		return err;
	}

	/* Wait for connect to finish. Semaphore given in lte_handler on event LTE_LC_EVT_NW_REG_STATUS. */
	k_sem_take(&lte_connected, K_FOREVER);
	LOG_INF("Connected to LTE network\n");

	err = gpio_pin_toggle_dt(&led);
	if (err) {
		LOG_ERR("Failed to toggle LED pin, error: %d", err);
	}
	LOG_INF("Led toggled.");

	return 0;
}

/** @brief Runs all init functions to set up a client-broker MQTT connection, then
 *  runs a keepalive loop in main to keep the MQTT connection alive.
 *  @returns Non-zero value on error, 0 if success.
*/
int network_init(void)
{
	int err = 0;

	err = modem_configure();
	if (err) {
		LOG_ERR("Failed to configure the modem, error: %d", err);
		return err;
	}

	err = client_init(&client);
	if (err) {
		LOG_ERR("Failed to initialize MQTT client: %d", err);
		return err;
	}

	err = imei_init();
	if (err) {
		LOG_ERR("Failed to initialize IMEI string of the device: %d", err);
		return err;
	}
	LOG_INF("Client initialized.");
	return 0;
}

/** @brief Entrypoint function for the MQTT connection keepalive thread. This 
 *  function is intended to run in it's own thread to run mqtt_live and maintain
 * 	a connection. It also handles return events from the MQTT connection file descriptors.
 *  @returns This function never returns.
*/
int mqtt_keepalive_thread(void) {
    k_sem_take(&keepalive_semaphore, K_FOREVER); // wait for main
	uint32_t connect_attempt = 0;
do_connect:
	int err = 0;
	if (connect_attempt++ > 0) {
		LOG_INF("Reconnecting in %d seconds...", CONFIG_MQTT_RECONNECT_DELAY_S);
		k_sleep(K_SECONDS(CONFIG_MQTT_RECONNECT_DELAY_S));
	}
	err = mqtt_connect(&client);
	if(err) {
		LOG_ERR("Error in mqtt_connect: %d", err);
		is_mqtt_connected = 0;
		goto do_connect;
	}
	is_mqtt_connected = 1;

	fds_init(&client, &fds);

	while (1) {
		int keepalive_time = mqtt_keepalive_time_left(&client);
		LOG_INF("Keepalive timer: %d", keepalive_time);
		err = poll(&fds, 1, mqtt_keepalive_time_left(&client));
		if (err < 0) {
			LOG_ERR("Error in poll for mqtt_keepalive_time_left: %d", errno);
			break;
		}

		err = mqtt_live(&client);
		if ((err != 0) && (err != -EAGAIN)) {
			LOG_ERR("Error in mqtt_live: %d", err);
			break;
		}
		
		if ((fds.revents & POLLIN) == POLLIN && is_mqtt_connected == 1) {
			err = mqtt_input(&client);
			if (err != 0) {
				LOG_ERR("Error in mqtt_input: %d", err);
				break;
			}
		}

		if ((fds.revents & POLLERR) == POLLERR) {
			LOG_ERR("POLLERR");
			break;
		}

		if((fds.revents & POLLNVAL) == POLLNVAL) {
			LOG_ERR("POLLNVAL");
			break;
		}
	}
	LOG_INF("Disconnecting MQTT client");
	err = mqtt_disconnect(&client);
	if (err) {
		LOG_ERR("Could not disconnect MQTT client: %d", err);
	}
	goto do_connect;

	/* never reached */
	return 0;
}

/** @brief Entrypoint function for the publish thread. This function runs a loop as 
 * 	often as defined by CONFIG_MQTT_PUBLISH_TIMER_MS. It dequeues a passing from the 
 *  passing buffer and attempts to publish it to the configured publishing topic.
 *  @returns This function never returns.
*/
int publish_thread(struct passing_buffer *buffer) {
    k_sem_take(&publish_semaphore, K_FOREVER); // wait for main
	int fail_count = 0;
	int err = 0;
	while (1) {
		if (is_mqtt_connected == 1 && buffer->size > 0) {
			uint32_t rfid_tag = 0;
			uint64_t time = 0;

			k_sem_take(&buffer_semaphore, K_FOREVER);
			dequeue(buffer, &rfid_tag, &time);
			k_sem_give(&buffer_semaphore);

			fail_count = 0;
			while (fail_count >= 0) {
				uint64_t current_time = (k_cycle_get_32()*1000)/sys_clock_hw_cycles_per_sec();
				uint64_t time_since_passing = current_time - time;
				uint8_t time_since_pass_buf[12] = {0};
				sprintf(time_since_pass_buf, "%d", time_since_passing);
				LOG_INF("time since passing: %s", time_since_pass_buf);

				LOG_INF("RFID tag: %X", rfid_tag);
				char rfid_tag_str[RFID_STR_LEN + 1] = {0};
				sprintf(rfid_tag_str, "%X", rfid_tag);

				char payload[80] = {0};
				strcpy(payload, imei_str);
				strcat(payload, ":");
				strcat(payload, rfid_tag_str);
				strcat(payload, ":");
				strcat(payload, time_since_pass_buf);

				err = data_publish(&client, MQTT_QOS_1_AT_LEAST_ONCE, payload, strlen(payload));
				if (err) {
					fail_count++;
					LOG_ERR("Failed to send message, %d", err);
					LOG_ERR("fail_count: %d", fail_count);
				} 
				else if (err == 0) {
					fail_count = -1;
					LOG_INF("Tag sent to broker.");
				}
			}
		} else {
			k_msleep(CONFIG_MQTT_PUBLISH_TIMER_MS);
		}
	}
}
```

## src/network.h
```c
#ifndef _NETWORK_H_
#define _NETWORK_H_
#include <zephyr/drivers/gpio.h>
#include "passing_buffer.h"

static const struct gpio_dt_spec led;

int mqtt_keepalive_thread(void);
int publish_thread(struct passing_buffer *buffer);
int network_init(void);

extern struct k_sem publish_semaphore;
extern struct k_sem keepalive_semaphore;
extern struct k_sem buffer_semaphore;
extern struct passing_buffer passing_buffer;

extern int is_mqtt_connected;

#endif /* _NETWORK_H_ */
```

## src/nfc.c
```c
#include <zephyr/kernel.h>
#include <zephyr/device.h>
#include <zephyr/devicetree.h>
#include <zephyr/drivers/i2c.h>
#include <zephyr/sys/util.h>
#include <zephyr/logging/log.h>
#include "nfc.h"
#include "passing_buffer.h"

#define PN532_I2C_ADDRESS 0x24

LOG_MODULE_REGISTER(PathPatrolNFC, LOG_LEVEL_INF);

//I2C stuff
#define I2C1_NODE DT_NODELABEL(i2c1)
static const struct device *i2c1_dev = DEVICE_DT_GET(I2C1_NODE);

uint8_t command[11] = {
    0x00, //preamble
    0x00, // 0x00FF command start
    0xFF, 
    4, //data length
    0xFC, //data length checksum

    0xD4, //D4= host -> PN532
    0x4A, //comand code for InListPassiveTarget
    0x01, //return 1 target
    0x00, //scan for Type A

    0xE1, //data checksum
    0x00, //postamble
    };
uint8_t SamConfig[12] = {
    0x00, //preamble
    0x00, // 0x00FF command start
    0xFF, 
    5, //data length
    0xFB, //data length checksum

    0xD4, //D4= host -> PN532
    0x14, //command code
    0x01, //normal mode
    0x00, //timeout: 00->no timeout
    0x01, //use IRQ

    0x16, //data checksum
    0x00, //postamble
};



/** @brief Function for printing raw bytes from a byte stream of any length.
 *  @param bytes Bytestream to print.
 *  @param len Length of bytestream.
 */
void print_bytes(uint8_t bytes[], uint32_t len){
    for(int i = 0; i < len; i++){
        LOG_INF("%02X ", bytes[i]);
    }
}

/** @brief Checks to see if the PN532 device is ready for messaging.
 *  @returns 0 if the device is ready, non-zero value if the device is not ready.
 */
int PN532_wait_for_RDY(){
    uint8_t buf[1];
    int ret;
    for(int i = 0; i < 500; i++){
        //give time
        k_msleep(20);

        ret = i2c_read(i2c1_dev, buf, 1, PN532_I2C_ADDRESS);
        if(ret){
            return -2;
        }

        if(buf[0] == 1){
            return 0;
        }
    }
    return -1;
}

/** @brief Attempts to send a command to the pn532 and waits for the response 
 * 
 * @param dev Pointer to the device structure for an I2C controller driver configured in controller mode.
 * @param i2c_address i2c address of the pn532
 * @param msg Memory pool from which the data is transferred.
 * @param msg_len Amount of bytes in data to be transferred
 * @param res_buf Memory pool to store ressponse
 * @param res_buf_len Amount of bytes in response
 * @param verbose prints debugging information
 * @return int 0 if success, negative if failed
 */
int pn532_send_receive_message(struct device *dev, uint8_t i2c_address, uint8_t *msg, uint32_t msg_len, uint8_t *res_buf, uint32_t res_buf_len, bool verbose){
    int ret;


    ret = i2c_write(dev, msg, msg_len, i2c_address);
    if (ret){
        return -1; //write error
    }

    if (verbose){
        LOG_INF("Msg sent");
    }

    ret = PN532_wait_for_RDY();
    if (ret){
        return -3+ret; //RDY wait error
    }

    if (verbose){
        LOG_INF("RDY");
    }

    ret = i2c_read(dev, res_buf, 7, i2c_address); //check for ACK
    if(ret){
        return -2; // read error
    }

    if (verbose){
        LOG_INF("Ack recieved");
    }

    ret = PN532_wait_for_RDY();
    if (ret){
        return -3+ret; //RDY wait error
    }

    if (verbose){
        LOG_INF("RDY");
    }

    ret = i2c_read(dev, res_buf, res_buf_len, i2c_address); //read response message
    if(ret){
        return -2; // read error
    }
    
    if (verbose){
        LOG_INF("Response read");
    }

    return 0;
}

/** @brief Initializes the PN532 for RFID scanning
 *  @returns 0 on success, non-zero value on error.
 */
int pn532_nfc_setup(){
    int ret;

    uint8_t res_buf[30];

    ret = pn532_send_receive_message(i2c1_dev, PN532_I2C_ADDRESS, SamConfig, 12, res_buf, 30, false);
    if(ret){
        LOG_ERR("Send/Receive error: %d", ret);
        return ret;
    }
}

/** @brief Attempts to read a recently scanned RFID.
 *  @param rfid_tag_buffer RFID tag buffer to write the gotten tag to.
 *  @returns 0 successful scan with a new RFID, non-zero value on error or no new RFID scan.
 */
int pn532_get_tag(uint32_t *rfid_tag_buffer){
    int ret;
    
    uint8_t res_buf[30];

    ret = pn532_send_receive_message(i2c1_dev, PN532_I2C_ADDRESS, command, 11, res_buf, 30, false);


    if(ret == -4){
        return ret;
    }else if (ret){
        return -1;
    }else{
        uint8_t length = res_buf[13];
        *rfid_tag_buffer = (int)res_buf[14] << 24 | (int)res_buf[15] << 16 | (int)res_buf[16] << 8 | (int)res_buf[17];
        return 0;
    }
}
```

## src/nfc.h
```c
#ifndef NFC_H
#define NFC_H

void print_bytes(uint8_t bytes[], uint32_t len);
int PN532_wait_for_RDY();
int pn532_send_receive_message(struct device *dev, uint8_t i2c_address, uint8_t *msg, uint32_t msg_len, uint8_t *res_buf, uint32_t res_buf_len, bool verbose);
int pn532_nfc_setup();
int pn532_get_tag_loop(uint32_t *rfid_tag_buffer);
int pn532_get_tag(uint32_t *rfid_tag_buffer);

#endif
```

## src/passing_buffer.c
```c
#include <zephyr/sys/util.h>
#include "passing_buffer.h"

int enqueue(struct passing_buffer *q, uint32_t* rfid, uint64_t *time){
    if (q->size < BUFFER_SIZE){
        q->rfid_buffer[q->back] = *rfid;
        q->time_buffer[q->back] = *time;
        q->back = (q->back+1)%BUFFER_SIZE;
        q->size++;
    }
    return 0;
}

int dequeue(struct passing_buffer *q, uint32_t* rfid, uint64_t *time){
    if (q->size > 0) {
        *rfid = q->rfid_buffer[q->front];
        *time = q->time_buffer[q->front];
        q->front = (q->front+1)%BUFFER_SIZE;
        q->size--;
    }
    return 0;
}

int size(struct passing_buffer *q){
    return q->size;
}
```

## src/passing_buffer.h
```c
#ifndef _PASSING_BUFFER_H_
#define _PASSING_BUFFER_H_

#define BUFFER_SIZE 128
#define RFID_STR_LEN 8


struct passing_buffer{
    int front;
    int back;
    int size;
    int rfid_buffer[BUFFER_SIZE];
    int time_buffer[BUFFER_SIZE]; 
};

int enqueue(struct passing_buffer *q, uint32_t* rfid, uint64_t *time);
int dequeue(struct passing_buffer *q, uint32_t* rfid, uint64_t *time);
int size(struct passing_buffer *q);

#endif
```
